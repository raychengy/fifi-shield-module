## boards/shields/fifi/Kconfig.defconfig
```kconfig
# Copyright (c) 2024 Ray Cheng
# SPDX-License-Identifier: MIT

if SHIELD_FIFI_CHOC_LEFT

config ZMK_KEYBOARD_NAME
    default "Fifi"

config ZMK_SPLIT_ROLE_CENTRAL
    default y

endif

if SHIELD_FIFI_CHOC_LEFT || SHIELD_FIFI_CHOC_RIGHT

config ZMK_SPLIT
    default y

endif
```

## boards/shields/fifi/Kconfig.shield
```kconfig
# Copyright (c) 2024 Ray Cheng
# SPDX-License-Identifier: MIT

config SHIELD_FIFI_CHOC_LEFT
    def_bool $(shields_list_contains,fifi_choc_left)

config SHIELD_FIFI_CHOC_RIGHT
    def_bool $(shields_list_contains,fifi_choc_right)
```
